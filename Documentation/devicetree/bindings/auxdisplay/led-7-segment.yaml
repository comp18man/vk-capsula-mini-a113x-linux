## Documentation/devicetree/bindings/auxdisplay/led-7-segment.yaml
```yaml
# SPDX-License-Identifier: (GPL-2.0-only OR BSD-2-Clause)
%YAML 1.2
---
$id: http://devicetree.org/schemas/auxdisplay/led-7-segment.yaml#
$schema: http://devicetree.org/meta-schemas/core.yaml#

title: Seven-segment display made of LEDs

maintainers:
  - cmp18 <comp18man@gmail.com>

description: |
  A display of one or more seven-segment digits whose segments are LEDs of
  one or more LED controllers rather than GPIOs. Each digit takes seven LEDs,
  segments a to g:

           -a-
          |   |
          f   b
          |   |
           -g-
          |   |
          e   c
          |   |
           -d-

  A decimal point or a colon is not part of a character cell and stays a
  plain LED.

properties:
  compatible:
    const: led-7-segment

  leds:
    $ref: /schemas/types.yaml#/definitions/phandle-array
    minItems: 7
    items:
      maxItems: 1
    description:
      The segment LEDs, a to g for each digit, digits from left to right. The
      count is a multiple of seven.

  default-brightness-level:
    $ref: /schemas/types.yaml#/definitions/uint32
    description:
      Brightness of a lit segment. Defaults to, and is capped at, the highest
      brightness all the LEDs support.

required:
  - compatible
  - leds

additionalProperties: false

examples:
  - |
    display {
        compatible = "led-7-segment";
        leds = <&seg_a>, <&seg_b>, <&seg_c>, <&seg_d>,
               <&seg_e>, <&seg_f>, <&seg_g>;
    };
```

## Documentation/devicetree/bindings/iio/light/rohm,bh1730fvc.yaml
```yaml
# SPDX-License-Identifier: (GPL-2.0-only OR BSD-2-Clause)
%YAML 1.2
---
$id: http://devicetree.org/schemas/iio/light/rohm,bh1730fvc.yaml#
$schema: http://devicetree.org/meta-schemas/core.yaml#

title: ROHM BH1730FVC ambient light sensor

maintainers:
  - cmp18 <comp18man@gmail.com>

description:
  Ambient light sensor with a visible and an infrared photodiode, on I2C at a
  fixed address.

properties:
  compatible:
    const: rohm,bh1730fvc

  reg:
    const: 0x29

  interrupts:
    maxItems: 1

required:
  - compatible
  - reg

additionalProperties: false

examples:
  - |
    i2c {
        #address-cells = <1>;
        #size-cells = <0>;

        light-sensor@29 {
            compatible = "rohm,bh1730fvc";
            reg = <0x29>;
        };
    };
```

## Documentation/devicetree/bindings/input/hynitron,csk05t.yaml
```yaml
# SPDX-License-Identifier: (GPL-2.0-only OR BSD-2-Clause)
%YAML 1.2
---
$id: http://devicetree.org/schemas/input/hynitron,csk05t.yaml#
$schema: http://devicetree.org/meta-schemas/core.yaml#

title: Hynitron CSK05T capacitive touch key controller

maintainers:
  - cmp18 <comp18man@gmail.com>

description:
  Five-channel capacitive touch key controller on I2C. The key state is
  polled; the INT output is reported never to produce an edge.

allOf:
  - $ref: input.yaml#

properties:
  compatible:
    const: hynitron,csk05t

  reg:
    maxItems: 1

  interrupts:
    maxItems: 1

  reset-gpios:
    maxItems: 1

  linux,keycodes:
    minItems: 5
    maxItems: 5
    description:
      Key codes of channels 0 to 4, in channel order. Without the property
      the channels report KEY_F1 to KEY_F5.

  poll-interval:
    default: 30

required:
  - compatible
  - reg

unevaluatedProperties: false

examples:
  - |
    #include <dt-bindings/gpio/gpio.h>
    #include <dt-bindings/input/input.h>

    i2c {
        #address-cells = <1>;
        #size-cells = <0>;

        keys@15 {
            compatible = "hynitron,csk05t";
            reg = <0x15>;
            reset-gpios = <&gpio 7 GPIO_ACTIVE_LOW>;
            linux,keycodes = <KEY_VOLUMEDOWN>, <KEY_MICMUTE>, <KEY_VOLUMEUP>,
                             <KEY_PROG1>, <KEY_VOICECOMMAND>;
        };
    };
```

## Documentation/devicetree/bindings/net/bluetooth/amlogic,w155s2-bt.yaml
```yaml
# SPDX-License-Identifier: (GPL-2.0-only OR BSD-2-Clause)
# Copyright (C) 2024 Amlogic, Inc. All rights reserved
%YAML 1.2
---
$id: http://devicetree.org/schemas/net/bluetooth/amlogic,w155s2-bt.yaml#
$schema: http://devicetree.org/meta-schemas/core.yaml#

title: Amlogic Bluetooth chips

description:
  The W155S2 is an Amlogic Bluetooth and Wi-Fi combo chip. It works on
  the standard H4 protocol via a 4-wire UART interface, with baud rates
  up to 4 Mbps. The W155S1 has no Bluetooth enable line; its Bluetooth
  core is powered through the chip's PMU over the Wi-Fi SDIO link, which
  the supply describes.

maintainers:
  - Yang Li <yang.li@amlogic.com>

properties:
  compatible:
    oneOf:
      - items:
          - enum:
              - amlogic,w265s1-bt
              - amlogic,w265p1-bt
          - const: amlogic,w155s2-bt
      - enum:
          - amlogic,w155s1-bt
          - amlogic,w155s2-bt
          - amlogic,w265s2-bt

  clocks:
    maxItems: 1
    description: clock provided to the controller (32.768KHz)

  enable-gpios:
    maxItems: 1

  vddio-supply:
    description: VDD_IO supply regulator handle

  firmware-name:
    maxItems: 1
    description: specify the path of firmware bin to load

required:
  - compatible
  - clocks
  - vddio-supply
  - firmware-name

allOf:
  - if:
      not:
        properties:
          compatible:
            contains:
              const: amlogic,w155s1-bt
    then:
      required:
        - enable-gpios

additionalProperties: false

examples:
  - |
    #include <dt-bindings/gpio/gpio.h>
    bluetooth {
        compatible = "amlogic,w155s2-bt";
        clocks = <&extclk>;
        enable-gpios = <&gpio 17 GPIO_ACTIVE_HIGH>;
        vddio-supply = <&wcn_3v3>;
        firmware-name = "amlogic/aml_w155s2_bt_uart.bin";
    };
```

## Documentation/devicetree/bindings/sound/neofidelity,ntp8918.yaml
```yaml
# SPDX-License-Identifier: (GPL-2.0-only OR BSD-2-Clause)
%YAML 1.2
---
$id: http://devicetree.org/schemas/sound/neofidelity,ntp8918.yaml#
$schema: http://devicetree.org/meta-schemas/core.yaml#

title: NeoFidelity NTP8918 Amplifier

maintainers:
  - Igor Prusov <ivprusov@salutedevices.com>

description:
  The NTP8918 is a single chip full digital audio amplifier
  including power stage for stereo amplifier system.
  The NTP8918 is integrated with versatile digital audio signal
  processing functions, high-performance, high-fidelity fully
  digital PWM modulator and two high-power full-bridge MOSFET
  power stages.

allOf:
  - $ref: dai-common.yaml#

properties:
  compatible:
    oneOf:
      - items:
          - const: neofidelity,ntp8910a
          - const: neofidelity,ntp8918
      - const: neofidelity,ntp8918

  reg:
    enum:
      - 0x2a
      - 0x2b
      - 0x2c
      - 0x2d

  reset-gpios:
    maxItems: 1

  '#sound-dai-cells':
    const: 0

  clocks:
    minItems: 1
    maxItems: 3

  clock-names:
    oneOf:
      - items:
          - const: bck
      - items:
          - const: wck
          - const: scl
          - const: bck

  hp-det-gpios:
    maxItems: 1
    description:
      Headphone jack detect. The speaker outputs are shut down while a plug
      is in.

  interrupts:
    maxItems: 1
    description:
      Interrupt on the hp-det-gpios line. Without it the line is polled.

dependencies:
  interrupts: [ hp-det-gpios ]

required:
  - compatible
  - reg

unevaluatedProperties: false

examples:
  - |
    #include <dt-bindings/gpio/gpio.h>

    i2c {
        #address-cells = <1>;
        #size-cells = <0>;

        audio-codec@2a {
            compatible = "neofidelity,ntp8918";
            #sound-dai-cells = <0>;
            reg = <0x2a>;
            clocks = <&clkc 150>, <&clkc 151>, <&clkc 152>;
            clock-names =  "wck", "scl", "bck";
            reset-gpios = <&gpio 5 GPIO_ACTIVE_LOW>;
        };
    };
```

## arch/arm64/configs/marusia_mini_defconfig
```kconfig
CONFIG_LOCALVERSION="-vk-mini-a113x"
CONFIG_EXPERT=y

CONFIG_MODULES=y
CONFIG_MODULE_UNLOAD=y

CONFIG_BLOCK=y
CONFIG_BLK_DEV_LOOP=y

CONFIG_ARCH_MESON=y
CONFIG_SMP=y
CONFIG_NR_CPUS=4

CONFIG_COMMON_CLK=y
CONFIG_COMMON_CLK_AXG=y
CONFIG_COMMON_CLK_AXG_AUDIO=y
CONFIG_RESET_CONTROLLER=y
CONFIG_RESET_MESON=y
CONFIG_RESET_GPIO=y
CONFIG_PINCTRL=y
CONFIG_PINCTRL_MESON=y
CONFIG_PINCTRL_MESON_AXG=y
CONFIG_GPIOLIB=y
CONFIG_GPIO_CDEV=y
# CONFIG_GPIO_CDEV_V1 is not set
CONFIG_MESON_IRQ_GPIO=y

CONFIG_TTY=y
CONFIG_SERIAL_MESON=y
CONFIG_SERIAL_MESON_CONSOLE=y
CONFIG_UNIX98_PTYS=y
# CONFIG_LEGACY_PTYS is not set
# CONFIG_SERIAL_8250 is not set
CONFIG_SERIAL_DEV_BUS=y
CONFIG_SERIAL_DEV_CTRL_TTYPORT=y

CONFIG_I2C=y
CONFIG_I2C_CHARDEV=y
CONFIG_I2C_MESON=y
CONFIG_SPI=y
CONFIG_SPI_MESON_SPICC=y
CONFIG_SPI_SPIDEV=y

CONFIG_SOUND=y
CONFIG_SND=y
CONFIG_SND_SOC=y
CONFIG_SND_MESON_AXG_SOUND_CARD=y
CONFIG_SND_MESON_AXG_TDM_INTERFACE=y
CONFIG_SND_MESON_AXG_TDM_FORMATTER=y
CONFIG_SND_MESON_AXG_TDMIN=y
CONFIG_SND_MESON_AXG_TDMOUT=y
CONFIG_SND_MESON_AXG_FIFO=y
CONFIG_SND_MESON_AXG_FRDDR=y
CONFIG_SND_MESON_AXG_TODDR=y
CONFIG_SND_MESON_AXG_PDM=y
CONFIG_SND_MESON_CARD_UTILS=y
CONFIG_SND_SOC_DMIC=y
CONFIG_SND_SOC_NTP8918=y

CONFIG_INPUT=y
CONFIG_INPUT_EVDEV=y

CONFIG_NEW_LEDS=y
CONFIG_LEDS_CLASS=y
CONFIG_LEDS_IS31FL32XX=y

CONFIG_LEDS_TRIGGERS=y
CONFIG_LEDS_TRIGGER_TIMER=y

CONFIG_AUXDISPLAY=y
CONFIG_SEG_LED_CLASS=y

CONFIG_IIO=y
CONFIG_BH1730=y

CONFIG_KEYBOARD_CSK05T=y

CONFIG_MTD=y
CONFIG_MTD_BLOCK=y
CONFIG_MTD_CMDLINE_PARTS=y
CONFIG_MTD_RAW_NAND=y
CONFIG_MTD_NAND_MESON=y
CONFIG_MTD_UBI=y
CONFIG_MTD_UBI_BLOCK=y

CONFIG_UBIFS_FS=y
CONFIG_UBIFS_FS_ADVANCED_COMPR=y
CONFIG_UBIFS_FS_LZO=y
CONFIG_UBIFS_FS_ZLIB=y
CONFIG_UBIFS_FS_ZSTD=y

CONFIG_BLK_DEV_INITRD=y
CONFIG_INITRAMFS_SOURCE=""
CONFIG_INITRAMFS_COMPRESSION_GZIP=y
CONFIG_RD_GZIP=y
# CONFIG_RD_BZIP2 is not set
# CONFIG_RD_LZMA is not set
# CONFIG_RD_XZ is not set
# CONFIG_RD_LZO is not set
# CONFIG_RD_LZ4 is not set
# CONFIG_RD_ZSTD is not set
CONFIG_BINFMT_ELF=y
CONFIG_BINFMT_SCRIPT=y

CONFIG_PROC_FS=y
CONFIG_SYSFS=y
CONFIG_TMPFS=y
CONFIG_DEVTMPFS=y
CONFIG_DEVTMPFS_MOUNT=y
CONFIG_CONFIGFS_FS=y

CONFIG_NET=y
CONFIG_UNIX=y
CONFIG_INET=y
CONFIG_PACKET=y
CONFIG_NETDEVICES=y

CONFIG_USB_SUPPORT=y
CONFIG_USB=y
CONFIG_USB_XHCI_HCD=y
CONFIG_USB_DWC3=y
CONFIG_USB_DWC3_HOST=y
CONFIG_USB_DWC3_MESON_G12A=y
CONFIG_USB_DWC2=y
CONFIG_USB_DWC2_PERIPHERAL=y
CONFIG_PHY_MESON_GXL_USB2=y
CONFIG_USB_GADGET=y
CONFIG_USB_CONFIGFS=y
CONFIG_USB_CONFIGFS_ACM=y
CONFIG_USB_CONFIGFS_ECM=y
CONFIG_USB_CONFIGFS_NCM=y
CONFIG_U_SERIAL_CONSOLE=y

CONFIG_MMC=y
CONFIG_MMC_MESON_GX=y
CONFIG_PWRSEQ_SIMPLE=y
CONFIG_REGULATOR=y
CONFIG_REGULATOR_FIXED_VOLTAGE=y
CONFIG_PWM=y
CONFIG_PWM_MESON=y
CONFIG_COMMON_CLK_PWM=y
CONFIG_CFG80211=m
CONFIG_CFG80211_WEXT=y
CONFIG_RFKILL=y
CONFIG_WLAN=y
CONFIG_WLAN_VENDOR_AMLOGIC=y
CONFIG_W1_AML=m

CONFIG_BT=m
CONFIG_BT_HCIUART=m
CONFIG_BT_HCIUART_SERDEV=y
CONFIG_BT_HCIUART_H4=y
CONFIG_BT_HCIUART_AML=y

CONFIG_EXTRA_FIRMWARE="eq_8918.bin"
CONFIG_EXTRA_FIRMWARE_DIR="firmware"

# CONFIG_EFI is not set
# CONFIG_VT is not set
# CONFIG_HID_SUPPORT is not set

CONFIG_DEVMEM=y

CONFIG_HW_RANDOM=y
CONFIG_HW_RANDOM_MESON=y
CONFIG_HW_RANDOM_ARM_SMCCC_TRNG=y
# CONFIG_CRYPTO_DEV_AMLOGIC_GXL is not set

CONFIG_CRYPTO_USER_API=y
CONFIG_CRYPTO_USER_API_HASH=y
CONFIG_CRYPTO_USER_API_SKCIPHER=y
CONFIG_CRYPTO_SHA1=y
CONFIG_CRYPTO_SHA256=y
CONFIG_CRYPTO_SHA512=y
CONFIG_CRYPTO_MD5=y
CONFIG_CRYPTO_HMAC=y
CONFIG_CRYPTO_CMAC=y
CONFIG_CRYPTO_AES=y
CONFIG_CRYPTO_DES=y
CONFIG_CRYPTO_CBC=y
CONFIG_CRYPTO_ECB=y

# CONFIG_MODULE_COMPRESS_GZIP is not set
CONFIG_MODULE_COMPRESS_ZSTD=y

CONFIG_DEBUG_INFO_NONE=y

CONFIG_PRINTK=y
CONFIG_PRINTK_TIME=y
CONFIG_MAGIC_SYSRQ=y
CONFIG_DEBUG_FS=y
```

## drivers/net/wireless/amlogic/w1/Kconfig
```kconfig
# SPDX-License-Identifier: GPL-2.0
config W1_AML
	tristate "Amlogic W1 (W155S1 / AW3155) SDIO Wi-Fi and Bluetooth power"
	depends on MMC && CFG80211 && REGULATOR
	depends on ARCH_MESON || COMPILE_TEST
	help
	  Support for the SDIO side of the Amlogic W1 combo chip found on
	  Amlogic boards: the Wi-Fi itself, and the power switch for its
	  Bluetooth part. The chip brings its own MAC layer, so the Wi-Fi
	  driver talks to cfg80211 directly and does not use mac80211.

	  RF calibration is read at probe time through the firmware loader
	  as aml/aml_wifi_rf_<serial>.txt, falling back to aml/aml_wifi_rf.txt,
	  so those files have to be reachable in /lib/firmware.

	  Bluetooth runs over a UART and is driven by BT_HCIUART_AML, but
	  its core has no enable line and is powered through the chip's PMU
	  over SDIO, so it needs this driver as well. When the device tree
	  gives the SDIO function 1 node a "regulator" child, the driver
	  registers it, and hci_aml takes it as its vddio-supply.

	  Built from the CoreELEC w1-aml tree; this is vendor code, not
	  kernel-style code.
```
